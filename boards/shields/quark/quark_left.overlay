// In boards/shields/quark/quark_left.overlay

#include "quark.dtsi"

&kscan0 {
    col-gpios
        = <&pro_micro 21 GPIO_ACTIVE_HIGH> // COL 0
        , <&pro_micro 9  GPIO_ACTIVE_HIGH> // COL 1
        , <&pro_micro 19 GPIO_ACTIVE_HIGH> // COL 2
        , <&pro_micro 18 GPIO_ACTIVE_HIGH> // COL 3
        , <&pro_micro 15 GPIO_ACTIVE_HIGH> // COL 4
        , <&pro_micro 14 GPIO_ACTIVE_HIGH> // COL 5
        ;
};