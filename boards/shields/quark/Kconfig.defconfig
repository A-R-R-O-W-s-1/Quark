## boards/shields/quark/Kconfig.defconfig
```kconfig
if SHIELD_QUARK_LEFT

config ZMK_KEYBOARD_NAME
    default "Quark"

config ZMK_SPLIT_ROLE_CENTRAL
    default y

endif

if SHIELD_QUARK_LEFT || SHIELD_QUARK_RIGHT

config ZMK_SPLIT
    default y

endif
```

## boards/shields/quark/Kconfig.shield
```kconfig
config SHIELD_QUARK_LEFT
    def_bool $(shields_list_contains,quark_left)

config SHIELD_QUARK_RIGHT
    def_bool $(shields_list_contains,quark_right)
```
